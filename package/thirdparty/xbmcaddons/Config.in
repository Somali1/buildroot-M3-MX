## package/thirdparty/xbmcaddons/Config.in
```kconfig
menu "XBMC addons"
    depends on BR2_PACKAGE_XBMC

comment "XBMC services"

source "package/thirdparty/xbmcaddons/opensubtitles/Config.in"

source "package/thirdparty/xbmcaddons/weather_underground/Config.in"

comment "XBMC scripts"

source "package/thirdparty/xbmcaddons/nm/Config.in"
source "package/thirdparty/xbmcaddons/hdtrailers_net/Config.in"
source "package/thirdparty/xbmcaddons/tlbbinstaller/Config.in"
source "package/thirdparty/xbmcaddons/tlbbwizard/Config.in"
source "package/thirdparty/xbmcaddons/tlbbrepo/Config.in"
source "package/thirdparty/xbmcaddons/artistslideshow/Config.in"
source "package/thirdparty/xbmcaddons/artwork_downloader/Config.in"
source "package/thirdparty/xbmcaddons/plugincache/Config.in"
source "package/thirdparty/xbmcaddons/favourites/Config.in"
source "package/thirdparty/xbmcaddons/globalsearch/Config.in"
source "package/thirdparty/xbmcaddons/libraryeditor/Config.in"
source "package/thirdparty/xbmcaddons/beautifulsoup/Config.in"

endmenu
```

## package/thirdparty/xbmcaddons/gojailbreak/Config.in
```kconfig
config BR2_PACKAGE_XBMC_ADDON_GOJAILBREAK
    bool "gojailbreak"
    default n
    help
      gojailbreak
```

## package/thirdparty/xbmcaddons/gomovies/Config.in
```kconfig
config BR2_PACKAGE_XBMC_ADDON_GOMOVIES
    bool "plugin.video.GOmovies"
    default n
    help
      GOmovies
```

## package/thirdparty/xbmcaddons/widgets/Config.in
```kconfig
config BR2_PACKAGE_XBMC_ADDON_WIDGETS
    bool "service.skin.widgets"
    default n
    help
      Skin widgets.
```
